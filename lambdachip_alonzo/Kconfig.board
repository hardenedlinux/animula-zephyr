## lambdachip_alonzo/Kconfig.board
```kconfig
# LambdaChip Alonzo board configuration

# Copyright (c) 2020-2021 LambdaChip
# SPDX-License-Identifier: Apache-2.0

config BOARD_LAMBDACHIP_ALONZO
	bool "LambdaChip Alonzo Board"
	depends on SOC_STM32F411XE
```

## lambdachip_alonzo/Kconfig.defconfig
```kconfig
# Lambdachip Alonzo board configuration

# Copyright (c) 2020 Lambdachip
# SPDX-License-Identifier: Apache-2.0

if BOARD_LAMBDACHIP_ALONZO

config BOARD
	default "lambdachip_alonzo"

config SPI_STM32_INTERRUPT
	default y
	depends on SPI

endif # BOARD_LAMBDACHIP_ALONZO
```

## lambdachip_alonzo/lambdachip_alonzo_defconfig
```kconfig
# SPDX-License-Identifier: Apache-2.0

CONFIG_ARM=y
CONFIG_BOARD_LAMBDACHIP_ALONZO=y
CONFIG_SOC_SERIES_STM32F4X=y
CONFIG_SOC_STM32F411XE=y
# 96MHz system clock (highest value to get a precise USB clock)
CONFIG_SYS_CLOCK_HW_CYCLES_PER_SEC=96000000

# Enable MPU
CONFIG_ARM_MPU=y

CONFIG_SERIAL=y

# console
CONFIG_CONSOLE=y
CONFIG_UART_CONSOLE=y

# enable pinmux
CONFIG_PINMUX=y

# enable GPIO
CONFIG_GPIO=y

# clock configuration
CONFIG_CLOCK_CONTROL=y

# Clock configuration for Cube Clock control driver
CONFIG_CLOCK_STM32_HSE_CLOCK=24000000
CONFIG_CLOCK_STM32_SYSCLK_SRC_PLL=y
# use HSE as PLL input
CONFIG_CLOCK_STM32_PLL_SRC_HSE=y
# however, the board does not have an external oscillator, so just use
# the 8MHz clock signal coming from integrated STLink
CONFIG_CLOCK_STM32_HSE_BYPASS=n

# produce 96MHz clock at PLL output
CONFIG_CLOCK_STM32_PLL_M_DIVISOR=12
CONFIG_CLOCK_STM32_PLL_N_MULTIPLIER=96
CONFIG_CLOCK_STM32_PLL_P_DIVISOR=2
CONFIG_CLOCK_STM32_PLL_Q_DIVISOR=4
CONFIG_CLOCK_STM32_AHB_PRESCALER=1

# APB1 clock must not exceed 50MHz limit
CONFIG_CLOCK_STM32_APB1_PRESCALER=2
CONFIG_CLOCK_STM32_APB2_PRESCALER=1


# { /* 96MHz */
#     .pllm = 12,
#     .plln = 96,
#     .pllp = 2,
#     .pllq = 4,
#     .pllr = 0,
#     .pll_source = RCC_CFGR_PLLSRC_HSE_CLK,
#     .hpre = RCC_CFGR_HPRE_DIV_NONE,
#     .ppre1 = RCC_CFGR_PPRE_DIV_2,
#     .ppre2 = RCC_CFGR_PPRE_DIV_NONE,
#     .voltage_scale = PWR_SCALE1,
#     .flash_config = FLASH_ACR_DCEN | FLASH_ACR_ICEN |
#             FLASH_ACR_LATENCY_2WS,
#     .ahb_frequency  = 84000000,
#     .apb1_frequency = 42000000,
#     .apb2_frequency = 84000000,
# },
```
